## meta-skyhawk/conf/layer.conf
```bitbake
# We have a conf and classes directory, add to BBPATH
BBPATH .= ":${LAYERDIR}"

# We have recipes-* directories, add to BBFILES
BBFILES += "${LAYERDIR}/recipes-*/*/*.bb \
            ${LAYERDIR}/recipes-*/*/*.bbappend"

BBFILE_COLLECTIONS += "meta-skyhawk"
BBFILE_PATTERN_meta-skyhawk = "^${LAYERDIR}/"
BBFILE_PRIORITY_meta-skyhawk = "6"

LAYERDEPENDS_meta-skyhawk = "core"
LAYERSERIES_COMPAT_meta-skyhawk = "kirkstone"
```
